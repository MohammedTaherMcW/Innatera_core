## innatera_core/project/configs/app_defconfig
```kconfig
CONFIG_ENABLE_FPU=y
CONFIG_RISCV_ISA_C=y
CONFIG_CONSOLE_ENABLE=y
CONFIG_LOG_LEVEL_INFO=y
CONFIG_PLL_INIT=y
CONFIG_T1_CPR=y
CONFIG_CYCLE_COUNTER_CV32E40P=y
CONFIG_GPIO=y
CONFIG_UART=y
CONFIG_CROSS_COMPILE="$(HOME)/.platformio/packages/toolchain-spine/bin/riscv32-corev-elf-"
            
```
